VERSION "Caretaker synthetic demo only"
BO_ 291 DemoPowertrain: 8 Vector__XXX
 SG_ VehicleSpeed : 0|16@1+ (0.01,0) [0|250] "km/h" Vector__XXX
