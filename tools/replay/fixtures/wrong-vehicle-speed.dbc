VERSION "Caretaker synthetic wrong-match demo only"
BO_ 291 DemoPowertrain: 8 Vector__XXX
 SG_ VehicleSpeed : 16|16@1+ (0.01,0) [0|250] "km/h" Vector__XXX
